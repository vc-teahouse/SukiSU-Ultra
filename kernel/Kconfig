## kernel/Kconfig
```kconfig
menu "KernelSU"

config KSU
	tristate "KernelSU function support"
	depends on OVERLAY_FS
	default y
	help
	  Enable kernel-level root privileges on Android System.
	  To compile as a module, choose M here: the
	  module will be called kernelsu.

config KSU_DEBUG
	bool "KernelSU debug mode"
	depends on KSU
	default n
	help
	  Enable KernelSU debug mode.

config KPM
	bool "Enable SukiSU KPM"
	depends on KSU && 64BIT
	default n
	help
	  Enabling this option will activate the KPM feature of SukiSU.
	  This option is suitable for scenarios where you need to force KPM to be enabled.
	  but it may affect system stability.
	select KALLSYMS
	select KALLSYMS_ALL

config KSU_THRONE_TRACKER_ALWAYS_THREADED
	bool "Always run throne_tracker in a kthread"
	default n
	help
	  Runs throne_tracker in a separate kthread, including the first run.
	  Significantly decreases boot time, but can cause crowning failure
	  on some FDE or FBEv1 setups.
	  If unsure, say n.

choice
    prompt "KernelSU hook type"
    depends on KSU
    default KSU_KPROBES_HOOK
    help
      Hook type for KernelSU

config KSU_KPROBES_HOOK
    bool "Hook KernelSU with Kprobes"
	depends on KPROBES
	help
	  If enabled, Hook required KernelSU syscalls with Kernel-probe.

config KSU_TRACEPOINT_HOOK
    bool "Hook KernelSU with Tracepoint"
	depends on TRACEPOINTS
	help
	  If enabled, Hook required KernelSU syscalls with Tracepoint.

config KSU_MANUAL_HOOK
    bool "Hook KernelSU manually"
	depends on KSU != m
	help
	  If enabled, Hook required KernelSU syscalls with manually-patched function.

endchoice

endmenu
```
